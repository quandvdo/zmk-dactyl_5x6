## boards/shields/volume_control/Kconfig.defconfig
```kconfig
if SHIELD_VOLUME_CONTROL

config ZMK_KEYBOARD_NAME
    default "volume_control"

endif # SHIELD_VOLUME_CONTROL
```

## boards/shields/volume_control/Kconfig.shield
```kconfig
config SHIELD_VOLUME_CONTROL
    def_bool $(shields_list_contains,volume_control)
```
